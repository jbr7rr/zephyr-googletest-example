## tests/lib/gtest-example/testcase.yaml
```yaml
common:
  tags: extensibility
  integration_platforms:
    - native_posix
tests:
  lib.something: 
    harness: gtest
```

## west.yml
```yaml
# Copyright (c) 2021 Nordic Semiconductor ASA
# SPDX-License-Identifier: Apache-2.0

manifest:
  self:
    west-commands: scripts/west-commands.yml

  remotes:
    - name: zephyr
      url-base: https://github.com/zephyrproject-rtos

  projects:
    - name: zephyr
      remote: zephyr
      repo-path: zephyr
      revision: main
      import: true
```
